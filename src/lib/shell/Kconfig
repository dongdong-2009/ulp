## src/tasks/Kconfig
```kconfig
#
# bldc configuration written in linux configuration language
#
# Written by miaofng@2010
#
#######################Please ensure the tasks in alphabetical order###############
choice 'task select'	" \
	NONE		CONFIG_TASK_NONE \
	APT		CONFIG_TASK_APT \
	BLDC		CONFIG_TASK_MOTOR \
	HVP		CONFIG_TASK_HVP \
	LWIP		CONFIG_LWIP_APP \
	MISC		CONFIG_TASK_MISC \
	MATRIX		CONFIG_TASK_MATRIX \
	NEST		CONFIG_TASK_NEST \
	PDI		CONFIG_TASK_PDI \
	Simulator	CONFIG_TASK_SIMULATOR \
	SM		CONFIG_TASK_STEPMOTOR \
	SSS		CONFIG_TASK_SSS \
	VVT		CONFIG_TASK_VVT \
	YBS		CONFIG_TASK_YBS \
	YBSREPEATER	CONFIG_TASK_YBSREPEATER \
	OID		CONFIG_TASK_OID \
	IRT		CONFIG_TASK_IRT \
" NONE

if [ "$CONFIG_TASK_APT" = "y" ]; then
	mainmenu_option next_comment
		comment 'apt applications select'
		source src/tasks/apt/Kconfig
	endmenu
fi

if [ "$CONFIG_TASK_MOTOR" = "y" ]; then
	mainmenu_option next_comment
		comment 'bldc'
		source src/tasks/bldc/Kconfig
	endmenu
fi

if [ "$CONFIG_TASK_MISC" = "y" ]; then
	mainmenu_option next_comment
		comment 'misc applications select'
		source src/tasks/misc/Kconfig
	endmenu
fi

if [ "$CONFIG_TASK_NEST" = "y" ]; then
	mainmenu_option next_comment
		comment 'nest'
		source src/tasks/nest/Kconfig
	endmenu
fi

if [ "$CONFIG_TASK_SIMULATOR" = "y" ]; then
	mainmenu_option next_comment
		comment 'simulator'
		source src/tasks/simulator/Kconfig
	endmenu
fi

if [ "$CONFIG_TASK_PDI" = "y" ]; then
	mainmenu_option next_comment
		comment 'pdi'
		source src/tasks/pdi/Kconfig
	endmenu
fi

if [ "$CONFIG_TASK_STEPMOTOR" = "y" ]; then
	mainmenu_option next_comment
		comment 'stepmotor'
		source src/tasks/sm/Kconfig
	endmenu
fi

if [ "$CONFIG_TASK_SSS" = "y" ]; then
	mainmenu_option next_comment
		comment 'sss'
		source src/tasks/sss/Kconfig
	endmenu
fi

if [ "$CONFIG_TASK_VVT" = "y" ]; then
	mainmenu_option next_comment
		comment 'vvt'
		source src/tasks/vvt/Kconfig
	endmenu
fi

if [ "$CONFIG_TASK_YBS" = "y" ]; then
	mainmenu_option next_comment
		comment 'ybs'
		source src/tasks/ybs/Kconfig
	endmenu
fi

if [ "$CONFIG_TASK_YBSREPEATER" = "y" ]; then
	mainmenu_option next_comment
		comment 'ybs_repeater'
		source src/tasks/ybs_repeater/Kconfig
	endmenu
fi

if [ "$CONFIG_TASK_OID" = "y" ]; then
	mainmenu_option next_comment
		comment 'oid'
		source src/tasks/oid/Kconfig
	endmenu
fi

if [ "$CONFIG_TASK_IRT" = "y" ]; then
	mainmenu_option next_comment
		comment 'irt'
		source src/tasks/irt/Kconfig
	endmenu
fi
```

## src/tasks/Kconfig.submenu
```kconfig
#
# bldc configuration written in linux configuration language
#
# Written by miaofng@2010
#

if [ "$CONFIG_TASK_MOTOR" = "y" ]; then
	mainmenu_option next_comment
		comment 'bldc'
		source src/tasks/bldc/Kconfig
	endmenu
fi

if [ "$CONFIG_TASK_VVT" = "y" ]; then
	mainmenu_option next_comment
		comment 'vvt'
		source src/tasks/vvt/Kconfig
	endmenu
fi

if [ "$CONFIG_TASK_STEPMOTOR" = "y" ]; then
	mainmenu_option next_comment
		comment 'stepmotor'
		source src/tasks/sm/Kconfig
	endmenu	
fi

if [ "$CONFIG_TASK_NEST" = "y" ]; then
	mainmenu_option next_comment
		comment 'nest'
		source src/tasks/nest/Kconfig
	endmenu	
fi

if [ "$CONFIG_TASK_ETHDEMO" = "y" ]; then
	mainmenu_option next_comment
		comment 'eth_demo'
		source src/tasks/eth_demo/Kconfig
	endmenu	
fi

if [ "$CONFIG_TASK_APT" = "y" ]; then
	mainmenu_option next_comment
		comment 'apt applications select'
		source src/tasks/apt/Kconfig
	endmenu	
fi

if [ "$CONFIG_TASK_MISC" = "y" ]; then
	mainmenu_option next_comment
		comment 'misc applications select'
		source src/tasks/misc/Kconfig
	endmenu	
fi

if [ "$CONFIG_TASK_SSS" = "y" ]; then
	mainmenu_option next_comment
		comment 'sss'
		source src/tasks/sss/Kconfig
	endmenu
fi

if [ "$CONFIG_TASK_PDI" = "y" ]; then
	mainmenu_option next_comment
		comment 'pdi'
		source src/tasks/pdi/Kconfig
	endmenu
fi

if [ "$CONFIG_TASK_SIMULATOR" = "y" ]; then
	mainmenu_option next_comment
		comment 'simulator'
		source src/tasks/simulator/Kconfig
	endmenu
fi
```

## src/tasks/eth_demo/Kconfig
```kconfig
#
# bldc configuration written in linux configuration language
#
# Written by miaofng@2010
#

choice 'tcp server type select'	" \
	DEFAULT		CONFIG_TCP_SERVER_DEF \
" DEFAULT
```

## src/tasks/irt/Kconfig
```kconfig
#
# bldc configuration written in linux configuration language
#
# Written by miaofng@2013
#

if [ "$CONFIG_TASK_IRT" = "y"]; then
	choice 'application select'	" \
		IRC		CONFIG_IRT_IRC \
		PROBE		CONFIG_IRT_PROBE \
		DPS		CONFIG_IRT_DPS \
		MXC5324		CONFIG_IRT_MXC5324 \
		UMX		CONFIG_IRT_UMX \
	" IRC
fi

if [ "$CONFIG_IRT_IRC" = "y" -o "$CONFIG_IRT_UMX" = "y"]; then
	int "irc instruction buffer words" CONFIG_IRC_INSWSZ 2048
fi
```

## src/tasks/misc/Kconfig
```kconfig
#
# bldc configuration written in linux configuration language
#
# Written by miaofng@2010
#

choice 'misc project configuration'	" \
	MISC_NULL			CONFIG_MISC_NULL \
	VALVE_HEAD_DEMO			CONFIG_MISC_VHD \
	SWITCH_LOAD_UNIT		CONFIG_MISC_SLU \
	BurnPanel_PowerTest		CONFIG_MISC_BPTEST \
	NI_ICT				CONFIG_MISC_ICT \
	ROWBOAT_SPC			CONFIG_MISC_SPC \
	MICROMETER_ADAPTER		CONFIG_MISC_MA \
	LPC1788DK			CONFIG_MISC_LPC1788DK \
	MUX_LOADBOX			CONFIG_MISC_MUX \
	YBS_MATRIX			CONFIG_MISC_MATRIX \
	GSM_DEMO			CONFIG_MISC_GSM \
	PMSM_TEST			CONFIG_MISC_PMSM \
	O2PT				CONFIG_MISC_O2PT \
	O2PTV2				CONFIG_MISC_O2PTV2 \
	NPS					CONFIG_MISC_NPS \
	O2PF				CONFIG_MISC_O2PF \
	HUBCTRL				CONFIG_MISC_HUBCTRL \
	HUBPDI				CONFIG_MISC_HUBPDI \
	COMPASS				CONFIG_MISC_COMPASS \
	VWPLC				CONFIG_MISC_VWPLC \
	VWHOST				CONFIG_MISC_VWHOST \
	VWSIG				CONFIG_MISC_VWSIG \
	VWPWR				CONFIG_MISC_VWPWR \
" VALVE_HEAD_DEMO

choice 'board hw version'	" \
	V1.0			CONFIG_HW_V1P0 \
	V1.1			CONFIG_HW_V1P1 \
	V1.2			CONFIG_HW_V1P2 \
	V1.3			CONFIG_HW_V1P3 \
	V1.4			CONFIG_HW_V1P4 \
	V1.5			CONFIG_HW_V1P5 \
	V2.0			CONFIG_HW_V2P0 \
	V2.1			CONFIG_HW_V2P1 \
	V2.2			CONFIG_HW_V2P2 \
	V2.3			CONFIG_HW_V2P3 \
	V2.4			CONFIG_HW_V2P4 \
	V2.5			CONFIG_HW_V2P5 \
	V3.0			CONFIG_HW_V3P0 \
	V4.0			CONFIG_HW_V4P0 \
	V5.0			CONFIG_HW_V5P0 \
" V1.0
```

## src/tasks/nest/Kconfig
```kconfig
#
# bldc configuration written in linux configuration language
#
# Written by miaofng@2010
#

choice 'nest project select'	" \
	MT22.1		CONFIG_NEST_MT22P1 \
	MT62.1		CONFIG_NEST_MT621 \
	MT92		CONFIG_NEST_MT92 \
	MT60		CONFIG_NEST_MT60 \
	MT60_0LD	CONFIG_NEST_MT60_OLD \
	MT22.1_OLD	CONFIG_NEST_MT22P1_OLD \
	MT80_OLD    	CONFIG_NEST_MT80_OLD \
	HCU_GAC		CONFIG_NEST_HCU_GAC \
	IGBT_BURN	CONFIG_NEST_IGBT_BURN \
	TESTFIXTURE	CONFIG_NEST_TESTFIXTURE \
	FIXTURE		CONFIG_NEST_FIXTURE \
	TCM8.0		CONFIG_NEST_TCM8P0\
	UPA		CONFIG_NEST_UPA\
" MT92

#nest type description:
#MT80_OLD 	a nest from ball system

int 'log message buffer size' CONFIG_NEST_LOG_SIZE 2048
bool 'test mode: auto restart' CONFIG_NEST_AUTORESTART
bool 'nest id function' CONFIG_NEST_ID
bool 'igbt burn function' CONFIG_NEST_BURN
bool 'wireless function' CONFIG_NEST_WIRELESS
```

## src/tasks/oid/Kconfig
```kconfig
#
# bldc configuration written in linux configuration language
#
# Written by miaofng@2013
#

choice 'application select'	" \
	DMM		CONFIG_OID_DMM \
	OID		CONFIG_OID_MAIN \
	YBS		CONFIG_OID_YBS \
" OID

choice 'oid hardware version'	" \
	V1.0		CONFIG_OID_HWV1 \
	V2.0		CONFIG_OID_HWV2 \
" V2.0

if [ "$CONFIG_OID_DMM" = "y"]; then
	choice 'aduc adc sinc3 filter setting'	" \
		50HZ			CONFIG_ADUC_50HZ \
		50HZ_CHOP		CONFIG_ADUC_50HZ_CHOP \
		10HZ_CHOP		CONFIG_ADUC_10HZ_CHOP \
	" 10HZ_CHOP
fi
```

## src/tasks/pdi/Kconfig
```kconfig
#
# bldc configuration written in linux configuration language
#
# Written by miaofng@2011
#

choice 'PDI Type'	" \
	ECU		CONFIG_PDI_ECU \
	RSU		CONFIG_PDI_RSU \
	RSU4	CONFIG_PDI_RSU4 \
" ECU

if [ "$CONFIG_PDI_ECU" = "y" ]; then
	choice 'ECU PDI Model'	" \
		SDM10_11		CONFIG_PDI_SDM10 \
		DM_DMA			CONFIG_PDI_DM \
		RC_N7			CONFIG_PDI_RC \
		B515			CONFIG_PDI_B515 \
		J04N			CONFIG_PDI_J04N \
		SDM30			CONFIG_PDI_SDM30 \
		M16				CONFIG_PDI_M16 \
		RP				CONFIG_PDI_RP \
	" SDM10_11
fi

if [ "$CONFIG_PDI_RSU4" = "y" ]; then
	choice 'RSU4 Models'	" \
		P71A		CONFIG_RSU_P71A \
		KP108		CONFIG_RSU_KP108 \
		VOLVO		CONFIG_RSU_VOLVO \
		DFL322		CONFIG_RSU_DFL322 \
		J71E		CONFIG_RSU_J71E \
		J71E_DHS	CONFIG_RSU_J71E_DHS \
	" P71A

	define_bool CONFIG_RSU4_NO_LM4040 y
	if [ "$CONFIG_RSU_P71A" = "y" -o "$CONFIG_RSU_KP108" = "y" -o "$CONFIG_RSU_VOLVO" = "y" ]; then
		define_bool CONFIG_RSU4_NO_LM4040 n
	fi

	define_bool CONFIG_RSU4_WITH_PROBE n
	if [ "$CONFIG_RSU_J71E_DHS" = "y" ]; then
		define_bool CONFIG_RSU4_WITH_PROBE y
	fi

	bool "without vref@lm4040" CONFIG_RSU4_NO_LM4040
	bool "light sensor->probe switch" CONFIG_RSU4_WITH_PROBE
fi
```

## src/tasks/simulator/Kconfig
```kconfig
#
# bldc configuration written in linux configuration language
#
# Written by david@2012
#

choice 'simulator board select'	" \
	WF_CORE		CONFIG_WEIFU_CORE \
	WF_LCM		CONFIG_WEIFU_LCM \
" WF_CORE

if [ "$CONFIG_WEIFU_CORE" = "y" ]; then
	int "rpm dds mclk frequency Hz?" CONFIG_DRIVER_RPM_DDS_MCLK 25000000
	int "vss dds mclk frequency Hz?" CONFIG_DRIVER_VSS_DDS_MCLK 25000000
fi
```

## src/tasks/sss/Kconfig
```kconfig
#
# bldc configuration written in linux configuration language
#
# Written by miaofng@2011
#

choice 'sss card type selection'	" \
	CTRL		CONFIG_SSS_CARD_CTRL \
	SIS		CONFIG_SSS_CARD_SIS \
" SIS
```

## src/tasks/vvt/Kconfig
```kconfig
#
# bldc configuration written in linux configuration language
#
# Written by miaofng@2010
#

choice 'vvt board select'	" \
	CORE	CONFIG_VVT_CORE \
	LCM	CONFIG_VVT_LCM \
" CORE

if [ "$CONFIG_VVT_CORE" = "y" ]; then
	bool "enable misfire speed debug output?" CONFIG_VVT_MISFIRE_DEBUG
	int "rpm dds mclk frequency Hz?" CONFIG_DRIVER_RPM_DDS_MCLK 25000000
	int "vss dds mclk frequency Hz?" CONFIG_DRIVER_VSS_DDS_MCLK 25000000
	int "knock dds mclk frequency Hz?" CONFIG_DRIVER_KNOCK_DDS_MCLK 25000000
	int "max knock sensor out voltage mVpp?" CONFIG_DRIVER_KNOCK_MVPP_MAX 255
fi
```

## src/tasks/ybs/Kconfig
```kconfig
#
# bldc configuration written in linux configuration language
#
# Written by miaofng@2013
#

choice 'application select'	" \
	YBS		CONFIG_YBS_SENSOR \
	CAL		CONFIG_YBS_CAL \
	DMM		CONFIG_YBS_DMM \
" YBS

if [ "$CONFIG_YBS_CAL" = "y" -o "$CONFIG_YBS_DMM" = "y"]; then
choice 'board version select'	" \
	V1.0		CONFIG_BRD_HWV10 \
	V2.0		CONFIG_BRD_HWV20 \
" V2.0
fi

if [ "$CONFIG_YBS_SENSOR" = "y"]; then
	if [ "$CONFIG_COMMON_MODBUS" = "y"]; then
		bool "enable modbus support" CONFIG_YBS_MODBUS n
	fi
	bool "ybs for pctest project" CONFIG_YBS_FOR_PCTEST n
fi
```

## src/tasks/ybs_repeater/Kconfig
```kconfig
#
# Written by king@2012
#

choice 'repeater board select'	" \
	LPC178X_DK	CONFIG_YREP_BOARD_DK \
	V1.0		CONFIG_YREP_V1P0 \
" LPC178X_DK
```
