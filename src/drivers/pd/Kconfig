## src/drivers/pd/Kconfig
```kconfig
#
# bldc configuration written in linux configuration language
#
# Written by miaofng@2010
#
bool "general pointing device support?" CONFIG_DRIVER_PD

if [ "$CONFIG_DRIVER_PD" = "y" ]; then
	choice 'touch screen chip select'	" \
		TSC2046	CONFIG_PD_TSC2046 \
		RSM1843	CONFIG_PD_RSM1843 \
	" TSC2046

	if [ "$CONFIG_PD_TSC2046" = "y" ]; then
		choice 'pd chip spi bus select'	" \
			SPI1	CONFIG_PD_BUS_SPI1 \
			SPI2	CONFIG_PD_BUS_SPI2 \
			SPI3	CONFIG_PD_BUS_SPI3 \
		" SPI2
	fi
	
	int "touch screen x axis resistor, unit: OHm" CONFIG_PD_RX 600
	bool "pd debug command" CONFIG_PD_CMD
fi
```

## src/drivers/spi/Kconfig
```kconfig
#
# bldc configuration written in linux configuration language
#
# Written by miaofng@2010
#
if [ "$CONFIG_CPU_STM32" = "y" ]; then
	mainmenu_option next_comment
		comment 'stm32 spi config'
		source src/drivers/spi/Kconfig.stm32
	endmenu
fi
if [ "$CONFIG_CPU_ADUC706X" = "y" ]; then
	mainmenu_option next_comment
		comment 'aduc706x spi config'
		source src/drivers/spi/Kconfig.aduc
	endmenu
fi
bool "chip virtual(vchip)" CONFIG_DRIVER_VCHIP
bool "chip ad9833(dds)" CONFIG_DRIVER_AD9833
bool "chip mcp41x(digi pot)" CONFIG_DRIVER_MCP41X
bool "chip dac1x8s(8x10bit dac)" CONFIG_DRIVER_DAC1X8S
bool "chip 74hct595 (shift register)" CONFIG_DRIVER_74HCT595
bool "chip mbi5025 (shift register)" CONFIG_DRIVER_MBI5025
if [ "$CONFIG_DRIVER_MBI5025" = "y" ]; then
int "mbi5025 clock(unit: KHz, <25MHz)" CONFIG_MBI5025_KHZ 1000
fi
bool "chip mcp23s17 (io expander)" CONFIG_DRIVER_MCP23S17
bool "chip ad5663 16bit dac" CONFIG_DRIVER_AD5663
```

## src/drivers/spi/Kconfig.aduc
```kconfig
#
# bldc configuration written in linux configuration language
#
# Written by miaofng@2010
#

bool "spi bus enable?" CONFIG_DRIVER_SPI
if [ "$CONFIG_DRIVER_SPI" = "y" ]; then
	choice 'spi work mode'	" \
		MASTER		CONFIG_SPI_MASTER \
		VCHIP(SLAVE)	CONFIG_SPI_VCHIP \
	" VCHIP(SLAVE)

	if [ "$CONFIG_SPI_MASTER" = "y" ]; then
		choice 'cs control method'	" \
			NONE	CONFIG_SPI_CS_NONE \
			HARD	CONFIG_SPI_CS_HARD \
			SOFT	CONFIG_SPI_CS_SOFT \
		" HARD
	fi
fi

if [ "$CONFIG_SPI_CS_SOFT" = "y"]; then
	mainmenu_option next_comment
		comment 'soft cs config'
	endmenu
	bool "P0.0/SPI_NSS as CS" CONFIG_SPI_CS_P00
fi
```

## src/drivers/spi/Kconfig.stm32
```kconfig
#
# bldc configuration written in linux configuration language
#
# Written by miaofng@2010
#

bool "spi bus 1?" CONFIG_DRIVER_SPI1
if [ "$CONFIG_DRIVER_SPI1" = "y" ]; then
	bool "enable dma support" CONFIG_SPI1_DMA
	choice 'cs control method'	" \
		NONE	CONFIG_SPI1_CS_NONE \
		HARD	CONFIG_SPI1_CS_HARD \
		SOFT	CONFIG_SPI1_CS_SOFT \
	" NONE
fi

bool "spi bus 2?" CONFIG_DRIVER_SPI2
if [ "$CONFIG_DRIVER_SPI2" = "y" ]; then
	bool "enable dma support" CONFIG_SPI2_DMA
	choice 'cs control method'	" \
		NONE	CONFIG_SPI2_CS_NONE \
		HARD	CONFIG_SPI2_CS_HARD \
		SOFT	CONFIG_SPI2_CS_SOFT \
	" NONE
fi

bool "spi bus 3?" CONFIG_DRIVER_SPI3
if [ "$CONFIG_DRIVER_SPI3" = "y" ]; then
	bool "enable dma support" CONFIG_SPI3_DMA
	bool "remap to PC10..12" CONFIG_SPI3_REMAP
	choice 'cs control method'	" \
		NONE	CONFIG_SPI3_CS_NONE \
		HARD	CONFIG_SPI3_CS_HARD \
		SOFT	CONFIG_SPI3_CS_SOFT \
	" NONE
fi

if [ "$CONFIG_SPI1_CS_SOFT" = "y" -o "$CONFIG_SPI2_CS_SOFT" = "y" -o "$CONFIG_SPI3_CS_SOFT" = "y" ]; then
	mainmenu_option next_comment
		comment 'soft cs config'
	endmenu

	bool "PA2 as CS" CONFIG_SPI_CS_PA2
	bool "PA3 as CS" CONFIG_SPI_CS_PA3
	bool "PA4/SPI1_NSS as CS" CONFIG_SPI_CS_PA4
	bool "PA12 as CS" CONFIG_SPI_CS_PA12

	bool "PB0 as CS" CONFIG_SPI_CS_PB0
	bool "PB1 as CS" CONFIG_SPI_CS_PB1
	bool "PB6 as CS" CONFIG_SPI_CS_PB6
	bool "PB7 as CS" CONFIG_SPI_CS_PB7
	bool "PB10 as CS" CONFIG_SPI_CS_PB10
	bool "PB12/SPI2_NSS as CS" CONFIG_SPI_CS_PB12

	bool "PC3 as CS" CONFIG_SPI_CS_PC3
	bool "PC4 as CS" CONFIG_SPI_CS_PC4
	bool "PC5 as CS" CONFIG_SPI_CS_PC5
	bool "PC6 as CS" CONFIG_SPI_CS_PC6
	bool "PC7 as CS" CONFIG_SPI_CS_PC7
	bool "PC8 as CS" CONFIG_SPI_CS_PC8

	bool "PD8 as CS" CONFIG_SPI_CS_PD8
	bool "PD9 as CS" CONFIG_SPI_CS_PD9
	bool "PD12 as CS" CONFIG_SPI_CS_PD12

	bool "PF11 as CS" CONFIG_SPI_CS_PF11

fi
```

## src/drivers/wdt/Kconfig
```kconfig
#
# bldc configuration written in linux configuration language
#
# Written by david@2012
#
bool "wdt driver?" CONFIG_DRIVER_WDT
if [ "$CONFIG_DRIVER_WDT" = "y" ]; then
	int 'Config WDT update time(ms)' CONFIG_WDT_PERIOD 500
	if [ "$CONFIG_CPU_STM32" = "y" ]; then
		choice 'iwdt start choice'	" \
			IWDT_HW_AUTO	CONFIG_STM32_WDTHW_AUTO \
			IWDT_HW_AUTO_OFF	CONFIG_STM32_WDTHW_AUTO_OFF \
			IWDT_HW	CONFIG_STM32_WDTHW \
			IWDT_SW	CONFIG_STM32_WDTSW \
		" IWDT_HW
	fi
fi
```

## src/drivers/wl/Kconfig
```kconfig
#
# bldc configuration written in linux configuration language
#
# Written by miaofng@2011
#

#common config options
bool "wireless support" CONFIG_DRIVER_WL

#RF chip select
if [ "$CONFIG_DRIVER_WL" = "y" ]; then
int "default tx/rx timeout ms" CONFIG_WL_MS 30
int "default frequency MHz" CONFIG_WL_MHZ 2430
hex "default device address" CONFIG_WL_ADDR 0x12345678
int "default tx fifo size" CONFIG_WL_TBUF_SZ 256
int "default rx fifo size" CONFIG_WL_RBUF_SZ 256
choice 'wireless chip select'	" \
	NRF24L01	CONFIG_WL_NRF \
	NONE		CONFIG_WL_NONE \
" NRF24L01

bool "wireless debug command" CONFIG_WL_CMD

fi
```

## src/lib/Kconfig
```kconfig
#
# bldc configuration written in linux configuration language
#
# Written by miaofng@2010
#

choice 'stm32 toolchain select'	" \
	gcc	CONFIG_TOOLCHAIN_GCC \
	iar	CONFIG_TOOLCHAIN_IAR \
" iar

source src/main/Kconfig
bool "shell - uart console" CONFIG_TASK_SHELL
bool "osd - simple gui console" CONFIG_TASK_OSD
bool "gui - simple gui console" CONFIG_TASK_GUI
bool "lwip -tcp/ip protocol stack" CONFIG_LIB_LWIP
bool "fatfs - vfat file system" CONFIG_LIB_FATFS
bool "common - common routine library" CONFIG_LIB_COMMON
bool "FreeRTOS - realtime operating system" CONFIG_LIB_FREERTOS
bool "mass storage - virtual usb disk" CONFIG_LIB_UDISK
bool "priv - copyright related library" CONFIG_LIB_PRIV
bool "lua - lua script language" CONFIG_LIB_LUA
bool "zbar - barcode scanner library" CONFIG_LIB_ZBAR
bool "instr - instrument support routines" CONFIG_LIB_INSTR
bool "pmsm - pmsm motor" CONFIG_LIB_PMSM

mainmenu_option next_comment
	comment 'library detail configuration'
	source src/lib/Kconfig.submenu
endmenu
```

## src/lib/Kconfig.submenu
```kconfig
#
# bldc configuration written in linux configuration language
#
# Written by miaofng@2010
#
if [ "$CONFIG_TOOLCHAIN_IAR" = "y" ]; then
	mainmenu_option next_comment
		comment 'iar'
		source src/lib/iar/Kconfig
	endmenu
fi

mainmenu_option next_comment
	comment 'sys'
	source src/lib/sys/Kconfig
endmenu

if [ "$CONFIG_TASK_SHELL" = "y" ]; then
	mainmenu_option next_comment
		comment 'shell'
		source src/lib/shell/Kconfig
	endmenu
fi

if [ "$CONFIG_TASK_OSD" = "y" ]; then
	mainmenu_option next_comment
		comment 'osd'
		source src/lib/osd/Kconfig
	endmenu
fi

if [ "$CONFIG_TASK_GUI" = "y" ]; then
	mainmenu_option next_comment
		comment 'gui'
		source src/lib/gui/Kconfig
	endmenu
fi

if [ "$CONFIG_LIB_LWIP" = "y" ]; then
	mainmenu_option next_comment
		comment 'lwip'
		source src/lib/lwip/Kconfig
	endmenu
fi

if [ "$CONFIG_LIB_FATFS" = "y" ]; then
	mainmenu_option next_comment
		comment 'fatfs'
		source src/lib/fatfs/Kconfig
	endmenu
fi

if [ "$CONFIG_LIB_COMMON" = "y" ]; then
	mainmenu_option next_comment
		comment 'common'
		source src/lib/common/Kconfig
	endmenu
fi

if [ "$CONFIG_LIB_PRIV" = "y" ]; then
	mainmenu_option next_comment
		comment 'priv'
		source src/lib/priv/Kconfig
	endmenu
fi

if [ "$CONFIG_LIB_UDISK" = "y" ]; then
	mainmenu_option next_comment
		comment 'mass storage'
		source src/lib/mass_storage/Kconfig
	endmenu
fi

if [ "$CONFIG_LIB_LUA" = "y" ]; then
	mainmenu_option next_comment
		comment 'lua script language'
		source src/lib/lua/Kconfig
	endmenu
fi

if [ "$CONFIG_LIB_ZBAR" = "y" ]; then
	mainmenu_option next_comment
		comment 'zbar scanner library'
		source src/lib/zbar/Kconfig
	endmenu
fi

if [ "$CONFIG_LIB_INSTR" = "y" ]; then
	mainmenu_option next_comment
		comment 'instr'
		source src/lib/instr/Kconfig
	endmenu
fi

if [ "$CONFIG_LIB_PMSM" = "y" ]; then
	mainmenu_option next_comment
		comment 'pmsm'
		source src/lib/pmsm/Kconfig
	endmenu
fi
```

## src/lib/lwip/Kconfig
```kconfig
#
# bldc configuration written in linux configuration language
#
# Written by miaofng@2010
#
# please refer to lwip/port/lwipopts.h for more
choice 'lwip version select'	" \
	LWIP-1.3.1	CONFIG_LWIP_V131 \
	LWIP-git	CONFIG_LWIP_GIT \
" LWIP-1.3.1
bool "non-OS based support(NO_SYS)?" NO_SYS
bool "use mac hardware cksum?" CHECKSUM_BY_HARDWARE
bool "dhcp support?" LWIP_DHCP
bool "use libc malloc?" MEM_LIBC_MALLOC
int "bytes reserved before ethernet header(ETH_PAD_SIZE)" ETH_PAD_SIZE 0
int "bytes of a link level header(PBUF_LINK_HLEN)?" PBUF_LINK_HLEN 14

choice 'default ip addr select'	" \
	DHCP		CONFIG_LWIP_IP_DHCP \
	192.168.8.4	CONFIG_LWIP_IP_192_168_8_4 \
	192.168.2.2	CONFIG_LWIP_IP_192_168_2_2 \
" 192.168.2.2
bool "app - hello world" CONFIG_LWIP_APP_HELLO
bool "app - tcp server" CONFIG_LWIP_APP_TCPSERVER
if [ "$CONFIG_LWIP_GIT" = "y" ]; then
	bool "app - http server" CONFIG_LWIP_APP_HTTPD
fi
if [ "$CONFIG_LWIP_APP_HTTPD" = "y" ]; then
	bool "app - http server CGI support" LWIP_HTTPD_CGI
	bool "app - http server SSI support" LWIP_HTTPD_SSI
	bool "app - http server with custom webpage" HTTPD_USE_CUSTOM_FSDATA
fi
```
