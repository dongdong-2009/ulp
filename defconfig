## src/Kconfig
```kconfig
#
# bldc configuration written in linux configuration language
#
# Written by miaofng@2010
#

mainmenu_name "bldc software platform settings"

mainmenu_option next_comment
  comment 'hardware'
  source src/board/Kconfig
endmenu

mainmenu_option next_comment
  comment 'software - drivers'
  source src/drivers/Kconfig
endmenu

mainmenu_option next_comment
  comment 'software - modules'
  source src/lib/Kconfig
endmenu

mainmenu_option next_comment
  comment 'software - tasks'
  source src/tasks/Kconfig
endmenu

mainmenu_option next_comment
  comment 'build options'
  source src/Kconfig.build
endmenu
```

## src/Kconfig.build
```kconfig
#
# bldc configuration written in linux configuration language
#
# Written by miaofng@2010
#

choice 'target file type'	" \
	bin	CONFIG_TARGET_BIN \
	lib	CONFIG_TARGET_LIB \
" bin

hex "stack size(hex)" CONFIG_STACK_SIZE 800
if [ "$CONFIG_CPU_ADUC706X" = "y" ]; then
hex "irq stack size(hex)" CONFIG_IRQSTACK_SIZE 80
fi
hex "heap size(hex)" CONFIG_HEAP_SIZE 1000
```

## src/board/Kconfig
```kconfig
#
# bldc configuration written in linux configuration language
#
# Written by miaofng@2010
#

mainmenu_option next_comment
	comment 'CPU - CONFIG'
	source src/cpu/Kconfig
endmenu

choice 'BOARD - CONFIG'	" \
	ARBITARY		CONFIG_BOARD_ARBITARY \
	HY_SMART_STM32		CONFIG_BOARD_HY_SMART \
" ARBITARY

if [ "$CONFIG_BOARD_HY_SMART" = "y" ]; then
	mainmenu_option next_comment
		comment 'HY Smart STM32 Board'
		source src/board/HY-Smart/Kconfig
	endmenu
fi
```

## src/cpu/Kconfig
```kconfig
#
# bldc configuration written in linux configuration language
#
# Written by miaofng@2010
#

bool "ulp cmsis support" CONFIG_CPU_CMSIS n
choice 'cpu family select'	" \
	stm32	CONFIG_CPU_STM32 \
	lm3s	CONFIG_CPU_LM3S \
	sam3u	CONFIG_CPU_SAM3U \
	lpc178x	CONFIG_CPU_LPC178X \
	aduc706x	CONFIG_CPU_ADUC706X \
" stm32

if [ "$CONFIG_CPU_STM32" = "y"]; then
	mainmenu_option next_comment
		comment 'CPU CONFIG - STM32'
		source src/cpu/stm32/Kconfig
	endmenu
fi

if [ "$CONFIG_CPU_LM3S" = "y"]; then
	mainmenu_option next_comment
		comment 'CPU CONFIG - LM3S'
		source src/cpu/lm3s/Kconfig
	endmenu
fi

if [ "$CONFIG_CPU_SAM3U" = "y"]; then
	mainmenu_option next_comment
		comment 'CPU CONFIG - SAM3U'
		source src/cpu/sam3u/Kconfig
	endmenu
fi

if [ "$CONFIG_CPU_LPC178X" = "y"]; then
	mainmenu_option next_comment
		comment 'CPU CONFIG - LPC178X'
		source src/cpu/lpc178x/Kconfig
	endmenu
fi

if [ "$CONFIG_CPU_ADUC706X" = "y"]; then
	mainmenu_option next_comment
		comment 'CPU CONFIG - ADUC706X'
		source src/cpu/aduc706x/Kconfig
	endmenu
fi
```

## src/cpu/aduc706x/Kconfig
```kconfig
#
# bldc configuration written in linux configuration language
#
# Written by miaofng@2013-1-1
#

choice 'system freq select'	" \
	10.24MHz	CONFIG_SYSCLK_CD0 \
	5.12MHz		CONFIG_SYSCLK_CD1 \
	2.56MHz		CONFIG_SYSCLK_CD2 \
	1.28MHz		CONFIG_SYSCLK_CD3 \
	640KHz		CONFIG_SYSCLK_CD4 \
	320KHz		CONFIG_SYSCLK_CD5 \
	160KHz		CONFIG_SYSCLK_CD6 \
	80KHz		CONFIG_SYSCLK_CD7 \
" 10.24MHz
bool "vector interrupt support" CONFIG_ADUC706X_VECTOR
bool "ADI std driver lib support" CONFIG_ADUC706X_ADILIB
```

## src/cpu/lm3s/Kconfig
```kconfig
#
# bldc configuration written in linux configuration language
#
# Written by miaofng@2010
#
int "high speed external clk freq?" CONFIG_HSE_VALUE 12000000
int "low speed external clk freq?" CONFIG_LSE_VALUE 32768
choice 'lm3s cpu type select'	" \
	LM3S8962	CONFIG_CPU_LM3S8962 \
	LM3S9B96	CONFIG_CPU_LM3S9B96 \
" LM3S8962
bool "use TI driverlib?" CONFIG_USE_TI_DRIVER_LIB y
```

## src/cpu/lpc178x/Kconfig
```kconfig
#
# bldc configuration written in linux configuration language
#
# Written by miaofng@2010
#
#int "high speed external clk freq?" CONFIG_HSE_VALUE 12000000
#int "low speed external clk freq?" CONFIG_LSE_VALUE 32768
#bool "use lpc178x internal RC OSC?" CONFIG_USE_HSI n

choice 'linkscript select'	" \
	RAM	CONFIG_ICF_RAM \
	ROM	CONFIG_ICF_ROM \
" ROM

bool "use lpc178x std periph driver?" CONFIG_USE_LPC_DRIVER y
```

## src/cpu/sam3u/Kconfig
```kconfig
#
# bldc configuration written in linux configuration language
#
# Written by miaofng@2010
#
int "high speed external clk freq?" CONFIG_HSE_VALUE 12000000
int "low speed external clk freq?" CONFIG_LSE_VALUE 32768
int "cpu core clk(mck) freq?" CONFIG_MCK_VALUE 48000000
choice 'sam3u cpu type select'	" \
	SAM3U1		CONFIG_CPU_SAM3U1 \
	SAM3U2		CONFIG_CPU_SAM3U2 \
	SAM3U4		CONFIG_CPU_SAM3U4 \
" SAM3U4
```

## src/cpu/stm32/Kconfig
```kconfig
#
# bldc configuration written in linux configuration language
#
# Written by miaofng@2010
#
int "high speed external clk freq?" CONFIG_HSE_VALUE 12000000
int "low speed external clk freq?" CONFIG_LSE_VALUE 32768
choice 'stm32 cpu type select'	" \
	ld	CONFIG_STM32F10X_LD \
	md	CONFIG_STM32F10X_MD \
	hi	CONFIG_STM32F10X_HD \
	cl	CONFIG_STM32F10X_CL \
	xl	CONFIG_STM32F10X_XL \
" md
choice 'stm32 std periph lib select'	" \
	v1.0	CONFIG_USE_STDPERIPH_DRIVER \
	v3.5	CONFIG_USE_STDPERIPH_V35 \
	none	CONFIG_USE_STDPERIPH_NONE \
" v1.0
if [ "$CONFIG_USE_STDPERIPH_DRIVER" = "y"]; then
bool "use stm32 internal RC OSC?" CONFIG_USE_HSI n
fi
choice 'system freq select(note: <= 36MHz only for using HSI!!!)'	" \
	24MHz	CONFIG_SYSCLK_FREQ_24MHz \
	36MHz	CONFIG_SYSCLK_FREQ_36MHz \
	48MHz	CONFIG_SYSCLK_FREQ_48MHz \
	56MHz	CONFIG_SYSCLK_FREQ_56MHz \
	64MHz	CONFIG_SYSCLK_FREQ_64MHz \
	72MHz	CONFIG_SYSCLK_FREQ_72MHz \
" 72MHz

if [ "$CONFIG_STM32F10X_CL" = "y"]; then
	bool "use stm32 std ethernet driver?" CONFIG_USE_STDETHERNET_DRIVER y
fi
bool "use stm32 usb device driver?" CONFIG_USE_STM32_USB_DRIVER n
```

## src/drivers/Kconfig
```kconfig
#
# bldc configuration written in linux configuration language
#
# Written by miaofng@2010
#

choice 'default console select'	" \
	UARTg	CONFIG_CONSOLE_UARTg \
	UART0	CONFIG_CONSOLE_UART0 \
	UART1	CONFIG_CONSOLE_UART1 \
	UART2	CONFIG_CONSOLE_UART2 \
" UART2
int 'console baudrate' CONFIG_CONSOLE_BAUD 115200
bool 'rtc driver' CONFIG_DRIVER_RTC

mainmenu_option next_comment
	comment 'uart config'
	source src/drivers/uart/Kconfig
endmenu

mainmenu_option next_comment
	comment 'lpt config'
	source src/drivers/lpt/Kconfig
endmenu

mainmenu_option next_comment
	comment 'spi config'
	source src/drivers/spi/Kconfig
endmenu

mainmenu_option next_comment
	comment 'i2c config'
	source src/drivers/i2c/Kconfig
endmenu

mainmenu_option next_comment
	comment 'can config'
	source src/drivers/can/Kconfig
endmenu

mainmenu_option next_comment
	comment 'lin config'
	source src/drivers/lin/Kconfig
endmenu

mainmenu_option next_comment
	comment 'usb config'
	source src/drivers/usb/Kconfig
endmenu

mainmenu_option next_comment
	comment 'mac config'
	source src/drivers/mac/Kconfig
endmenu

mainmenu_option next_comment
	comment 'lcd config'
	source src/drivers/lcd/Kconfig
endmenu

mainmenu_option next_comment
	comment 'pd config'
	source src/drivers/pd/Kconfig
endmenu

mainmenu_option next_comment
	comment 'key config'
	source src/drivers/key/Kconfig
endmenu

mainmenu_option next_comment
	comment 'pwm config'
	source src/drivers/pwm/Kconfig
endmenu

mainmenu_option next_comment
	comment 'pwmin config'
	source src/drivers/pwmin/Kconfig
endmenu

mainmenu_option next_comment
	comment 'pulse counter config'
	source src/drivers/counter/Kconfig
endmenu

mainmenu_option next_comment
	comment 'disk config'
	source src/drivers/disk/Kconfig
endmenu

mainmenu_option next_comment
	comment 'misc config'
	source src/drivers/Kconfig.misc
endmenu

mainmenu_option next_comment
	comment 'flash config'
	source src/drivers/flash/Kconfig
endmenu

mainmenu_option next_comment
	comment 'wireless config'
	source src/drivers/wl/Kconfig
endmenu

mainmenu_option next_comment
	comment 'video config'
	source src/drivers/video/Kconfig
endmenu


mainmenu_option next_comment
	comment 'wdt config'
	source src/drivers/wdt/Kconfig
endmenu

mainmenu_option next_comment
	comment 'dac config'
	source src/drivers/dac/Kconfig
endmenu

mainmenu_option next_comment
	comment 'pmsmd config'
	source src/drivers/pmsmd/Kconfig
endmenu
```

## src/drivers/disk/Kconfig
```kconfig
#
# bldc configuration written in linux configuration language
#
# Written by miaofng@2010
#
bool "general disk driver?" CONFIG_DRIVER_DISK
if [ "$CONFIG_DRIVER_DISK" = "y" ]; then
	choice 'sd card bus select'	" \
		SPI1	CONFIG_SD_BUS_SPI1 \
		SPI2	CONFIG_SD_BUS_SPI2 \
	" SPI
fi
```

## src/drivers/i2c/Kconfig
```kconfig
#
# bldc configuration written in linux configuration language
#
# Written by miaofng@2010
#
bool "i2c bus 1?" CONFIG_DRIVER_I2C1
bool "i2c bus 2?" CONFIG_DRIVER_I2C2
bool "gpio emulated i2c bus" CONFIG_I2C_SOFT
if [ "$CONFIG_I2C_SOFT" = "y" ]; then
	choice 'bus pinmap type'	" \
		HW_I2C1	CONFIG_I2C_PINMAP_I2C1 \
		HW_I2C2	CONFIG_I2C_PINMAP_I2C2 \
		HW_I2C1_REMAP	CONFIG_I2C_REMAP_I2C1 \
	" HW_I2C2
fi
bool "chip at24cxx(eeprom)" CONFIG_DRIVER_AT24CXX
bool "chip mcp23017 (IO explander)" CONFIG_DRIVER_MCP23017
if [ "$CONFIG_DRIVER_I2C1" = "y" ]; then
	if [ "$CONFIG_CPU_STM32" = "y" ]; then
		bool "remap PB8/9 as SCL/SDA pin" CONFIG_I2C1_REMAP
	fi
fi
```

## src/drivers/key/Kconfig
```kconfig
#
# bldc configuration written in linux configuration language
#
# Written by miaofng@2010
#
bool "general key driver" CONFIG_DRIVER_KEYBOARD
if [ "$CONFIG_DRIVER_KEYBOARD" = "y" ]; then
	bool "adc key driver" CONFIG_DRIVER_ADCKEY
	if [ "$CONFIG_DRIVER_ADCKEY" = "y" ]; then
		choice 'STM32 ADC Channel select'	" \
			ADC12_IN0 CONFIG_ADCKEY_ADC12_IN0 \
			ADC12_IN8 CONFIG_ADCKEY_ADC12_IN8 \
		" ADC12_IN0
	fi
	bool "gpio key driver" CONFIG_DRIVER_GPIOKEY
	if [ "$CONFIG_DRIVER_GPIOKEY" = "y" ]; then
		choice 'keyboard layout select'	" \
			goldbull	CONFIG_GPIOKEY_LAYOUT_GB \
			vvt		CONFIG_GPIOKEY_LAYOUT_VVT \
			custom		CONFIG_GPIOKEY_LAYOUT_CUSTOM \
		" custom
	fi
	bool "general remote control driver" CONFIG_DRIVER_RCKEY
	if [ "$CONFIG_DRIVER_RCKEY" = "y" ]; then
		choice 'remote control protocol'	" \
			rc5	CONFIG_RCKEY_PROTOCOL_RC5 \
			ppm	CONFIG_RCKEY_PROTOCOL_PPM \
		" rc5
	fi
	bool "general encoder driver" CONFIG_DRIVER_ENCODER
	if [ "$CONFIG_DRIVER_ENCODER" = "y" ]; then
		mainmenu_option next_comment
		comment 'encoder config'
		source src/drivers/key/encoder/Kconfig
		endmenu
	fi
fi
```

## src/drivers/key/encoder/Kconfig
```kconfig
#
# bldc configuration written in linux configuration language
#
# Written by miaofng@2010
#
choice 'encoder interface select'	" \
	STM32_TIM4	CONFIG_ENCODER_STM32_TIM4 \
	STM32_TIM2	CONFIG_ENCODER_STM32_TIM2 \
" STM32_TIM4
bool "encoder cmd support" CONFIG_ENCODER_CMD
```

## src/drivers/lcd/Kconfig
```kconfig
#
# bldc configuration written in linux configuration language
#
# Written by miaofng@2010
#
bool "general lcd support?" CONFIG_DRIVER_LCD

if [ "$CONFIG_DRIVER_LCD" = "y" ]; then
choice 'lcd select'	" \
	LCD1602	CONFIG_LCD_1602 \
	JHD204A	CONFIG_LCD_JHD204A \
	CUSTOM	CONFIG_CUSTOM_DISPLAY\
	ILI932X	CONFIG_LCD_ILI932X \
	S6B33C	CONFIG_LCD_S6B33 \
	WX1800F	CONFIG_LCD_ILI9161 \
	KLD24A23/TM024HBZ13 CONFIG_LCD_ILI932X \
	TFT8K0940/TC320 CONFIG_LCD_SSD1289 \
" LCD1602

choice 'lcd rotation degree select'	" \
	CW000	CONFIG_LCD_ROT_000 \
	CW090	CONFIG_LCD_ROT_090 \
	CW180	CONFIG_LCD_ROT_180 \
	CW270	CONFIG_LCD_ROT_270 \
" CW000

choice 'lcd fontlib select'	" \
	TNR08X16	CONFIG_FONT_TNR08X16 \
	TNR16X32	CONFIG_FONT_TNR16X32 \
" TNR16X32

bool "shell cmd for lcd debug" CONFIG_LCD_CMD
fi
```

## src/drivers/lpt/Kconfig
```kconfig
#
# bldc configuration written in linux configuration language
#
# Written by miaofng@2010
#

#gpio emulate
choice 'lpt bus hardware select'	" \
	GPIO	CONFIG_LPT_GPIO \
	FSMC	CONFIG_LPT_FSMC \
	NONE	CONFIG_LPT_NONE \
" NONE
if [ "$CONFIG_LPT_NONE" != "y" ]; then
	#bus period
	int "default bus period, unit: ns" CONFIG_LPT_T 400
	#bus access time
	int "default bus access time, unit: ns" CONFIG_LPT_TP 200
	bool "enable lpt debug command?" CONFIG_LPT_CMD
fi
if [ "$CONFIG_LPT_FSMC" = "y" ]; then
	choice 'LCD RS pin select(such as: BANK1/A16, ADDR 0x01->0x60020000)'	" \
		PD11/A16	CONFIG_LPT_A16 \
		PD12/A17	CONFIG_LPT_A17 \
	" PD11/A16
fi
if [ "$CONFIG_LPT_GPIO" = "y" ]; then
	choice 'bus timing mode'	" \
		I80	CONFIG_LPT_MODE_I80 \
		M68	CONFIG_LPT_MODE_M68 \
	" I80
	choice 'bus pinmap type'	" \
		DEF8BIT	CONFIG_LPT_PINMAP_DEF8 \
		DEF16BIT	CONFIG_LPT_PINMAP_DEF16 \
		ZF32	CONFIG_LPT_PINMAP_ZF32 \
		APT		CONFIG_LPT_PINMAP_APT \
	" DEF8BIT
	choice 'data bus drive type'	" \
		OPENDRAIN	CONFIG_LPT_DB_OD \
		PUSHPULL	CONFIG_LPT_DB_PP \
	" OPENDRAIN
fi

#extern memory bus such as FSMC
```

## src/drivers/mac/Kconfig
```kconfig
#
# bldc configuration written in linux configuration language
#
# Written by miaofng@2010
#

bool "general mac drivers?" CONFIG_DRIVER_MAC
if [ "$CONFIG_DRIVER_MAC" = "y" ]; then
	choice 'mac chip select'	" \
		STM32		CONFIG_MAC_STM32 \
		LM3S		CONFIG_MAC_LM3S \
		ENC424J600(100M)	CONFIG_MAC_ENC424J600 \
		ENC28J60(10M)	CONFIG_MAC_ENC28J60 \
	" STM32
fi
```
