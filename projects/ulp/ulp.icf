
place in RAM_region   { section .shell.cmd };
keep { section .shell.cmd };
place in RAM_region   { section .sys.task };
keep { section .sys.task };
place in RAM_region   { section .sys.lib };
keep { section .sys.lib };
place in RAM_region   { section .driver };
keep { section .driver };

/*nvm support*/
place in RAM_region   { section .nvm.ram };
keep { section .nvm.ram };
